## meta-opos/conf/layer.conf
```bitbake
BBPATH .= ":${LAYERDIR}"
BBFILES += "${LAYERDIR}/recipes-*/*/*.bb"

BBFILE_COLLECTIONS += "opos"
BBFILE_PATTERN_opos = "^${LAYERDIR}/"
BBFILE_PRIORITY_opos = "6"

BB_SRCREV_POLICY = "clear"

# Layer variables
OPOS_SYSROOT = "sysroot"

MAINTAINER = "olepor@ifi.uio.no"

# WORKDIR will default to tmp/work/PN-PV
CC="${${TARGET_ARCH}-elf-gcc --sysroot=${WORKDIR} -isystem=${WORKDIR}/usr/include}"
AS="${TARGET_ARCH}-elf-as"
LD="${TARGET_ARCH}-elf-ld"
```
